## Kconfig
```kconfig
menu "HAMQTT"

    config HAMQTT_DEVICE_MAX_COMPONENTS
        int "Max HAMQTT Device Components"
        default 16
        help
            Enter the number of compontents a HAMQTT Device can store.

    config HAMQTT_MAX_CHAR_BUF_SIZE
        int "Maximum Character Buffer Size"
        default 128
        help
            The maximum characters an internal buffer can hold. Should be large to prevent clipping issues, but small enough to prevent stack-overflow.

    config HAMQTT_MQTT_CONNECT_TIMEOUT_MS
        int "MQTT Connection Timeout (ms)"
        default 10000
        help
            Enter the amount of time (in milliseconds) that MQTT will spend attemping to connect before it gives up.

endmenu
```
